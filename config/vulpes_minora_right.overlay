// Trackpoint configuration
// See https://github.com/infused-kim/kb_zmk_ps2_mouse_trackpoint_driver-zmk_config/commit/3e2687feea694529e9d2444a6b5df2a0823612df for worked example with comments

// Pick the driver
#define MOUSE_PS2_DRIVER_UART

// Configure the data and clock pins
#define MOUSE_PS2_PIN_SCL_PRO_MICRO <&pro_micro 2 GPIO_ACTIVE_HIGH>
#define MOUSE_PS2_PIN_SDA_PRO_MICRO <&pro_micro 3 GPIO_ACTIVE_HIGH>
#define MOUSE_PS2_PIN_SDA_PINCTRL <NRF_PSEL(UART_RX, 0, 20)>

// Configure the power-on-reset pin
#define MOUSE_PS2_PIN_RST_PRO_MICRO <&pro_micro 18 GPIO_ACTIVE_HIGH>

// Pull in the additional trackpoint configs that you usually do not need to touch
#include "includes/_trackpoint_overlay.dtsi"

// Configure trackpoint rotation
&mouse_ps2_input_listener {
    y-invert;
};
