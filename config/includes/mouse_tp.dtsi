#ifdef HAS_MOUSE_TP
  #include <dt-bindings/zmk/mouse.h>

  // pull in the custom trackpoint keycodes
  #include "_trackpoint_keycodes.dtsi"

  // Only apply these settings on the side that has the TP connected
  // (usually the right side)
  #ifdef MOUSE_PS2_DT_PRESENT

    // pull in the fully defined input listener and mouse driver configs
    #include "_trackpoint_default_drivers.dtsi"

    // enable PS2 mouse devices
    #include "_trackpoint_activate.dtsi"

  #endif  // MOUSE_PS2_DT_PRESENT
#endif  // HAS_MOUSE_TP
