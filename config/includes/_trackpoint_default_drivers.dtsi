// Trackpoint configuration
// See https://github.com/infused-kim/kb_zmk_ps2_mouse_trackpoint_driver-zmk_config/commit/3e2687feea694529e9d2444a6b5df2a0823612df for worked example with comments

/*
NOTE: this is NOT a complete trackpoint config
This only contains the blocks for listener and driver configs from the sample mouse_tp.dtsi file which enumerate the full set of options
I've split them out here just to declutter the file
*/

/*
* Input Listener Config
*/

&mouse_ps2_input_listener {

    // Adjust pointing device axes.
    // This adjusts the values inside the zmk driver. Some
    // trackpoints also allow you to adjust it in their firmware. Check
    // the driver options below for more info.
    // xy-swap;
    // x-invert;
    // y-invert;

    // Set the layer that should automatically activate when the mouse is
    // moving.
    // layer-toggle = <0>;  // set default behavior to just toggle the base layer on mouse movement

    // How long the mouse needs to move for before the layer is activated (to
    // avoid accidental activations while typing) (Default: 250)
    layer-toggle-delay-ms = <250>;

    // How long to wait, after the last mouse movement, before deactivating
    // the layer (Default: 250)
    layer-toggle-timeout-ms = <250>;
};


/*
* Mouse Driver Settings
*/

&mouse_ps2 {

    // How sensitive the TP is (Default: 128)
    // tp-sensitivity = <128>;


    // The maximum mouse movement speed the TP will accelarate to
    // (Default: 97)
    // tp-val6-upper-speed = <97>;


    // Negative Inertia (Default: 6)
    // Makes the TP feel more responsive and "overshoot" less.
    // tp-neg-inertia = <6>;


    // Enable clicking by tapping on the TP.
    // Not all TPs support this.
    // tp-press-to-select;
    // tp-press-to-select-threshold = <10>;


    // Adjust axis settings on the TP
    // Works only on some trackpoints, but may be properly considered by the
    // trackpoint's acceleration features (which may or may not have an
    // impact).
    //
    // Alternatively consider achieving the same effect using the
    //  `input-listener` settings below.
    // tp-xy-swap;
    // tp-x-invert;
    // tp-y-invert;


    // Set sampling rate
    //
    // The frequency at which the mouse samples and sends data (in hz).
    // The default rate is 100. You can try lowering it if you experience
    // connection errors.
    //
    // Higher values than 100 are no improvement in my experience, but will
    // increase battery life and potentially errors in transmissions.
    //
    // These values are allowed: 10,20,40,60,80,100,200
    // sampling-rate = <60>;


    // Disables clicking.
    // Useful when using the PS2 GPIO driver that is prone to
    // erros in transmissions to reduce accidental clicks.
    // disable-clicking;


    // Enable scroll wheel
    // For mouse devices supporting the Intellimouse extension. Not relevant
    // for trackpoints
    // scroll-mode;

};