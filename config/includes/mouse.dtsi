#define ZMK_MOUSE_DEFAULT_MOVE_VAL 1500  // 600
#define ZMK_MOUSE_DEFAULT_SCRL_VAL -10    // 10

#include <dt-bindings/zmk/mouse.h>

&mmv {
    acceleration-exponent = <1>;      // 1
    time-to-max-speed-ms = <500>;     // 300
    delay-ms = <0>;                   // 0
};

&msc {
    acceleration-exponent = <0>;      // 0
    time-to-max-speed-ms = <100>;      // 300
    delay-ms = <0>;                   // 0
};

// see https://discord.com/channels/719497620560543766/845285481888743434/1212105867411988540 for tweaking mousekey settings
/*
It's not documented properly yet, but here is a crash course. There are four knobs to tweak:
Acceleration exponent: This is constant for 0, linear for 1 etc.
Time to max speed: How long it takes to reach max speed (last point), obeying the acceleration exponent
Delay: Time held until movement happens
Max speed: self explanatory
*/
