// Trackpoint configuration
// See https://github.com/infused-kim/kb_zmk_ps2_mouse_trackpoint_driver-zmk_config/commit/3e2687feea694529e9d2444a6b5df2a0823612df for worked example with comments
// See https://github.com/zmkfirmware/zmk/tree/main/app/boards/shields/nice_view_adapter for the pin assignments used for the nice view that we hijacked

#include "includes/tpoint-listener.dtsi"
#include "includes/tpoint-ps2.dtsi"

&tpoint_listener {
    status = "okay";
    device = <&tpoint0>;
};