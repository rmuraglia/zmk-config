## boards/shields/bad_wings/Kconfig.defconfig
```kconfig
# Copyright (c) 2022 The ZMK Contributors
# SPDX-License-Identifier: MIT

if SHIELD_BAD_WINGS

config ZMK_KEYBOARD_NAME
    default "Bad Wings"

endif
```

## boards/shields/bad_wings/Kconfig.shield
```kconfig
# Copyright (c) 2022 The ZMK Contributors
# SPDX-License-Identifier: MIT

config SHIELD_BAD_WINGS
    def_bool $(shields_list_contains,bad_wings)
    select SPI
```

## config/Kconfig.defconfig
```kconfig
if SHIELD_VULPES_MINORA_LEFT
    config ZMK_SPLIT_ROLE_CENTRAL
        default y
endif
```

## config/west.yml
```yaml
manifest:
  remotes:
    - name: zmkfirmware
      url-base: https://github.com/zmkfirmware
    # Additional modules containing boards/shields/custom code can be listed here as well
    # See https://docs.zephyrproject.org/3.2.0/develop/west/manifest.html#projects
    - name: sadekbaroudi
      url-base: https://github.com/sadekbaroudi
    - name: caksoylar
      url-base: https://github.com/caksoylar
    - name: infused-kim
      url-base: https://github.com/infused-kim
    - name: badjeff
      url-base: https://github.com/badjeff
    - name: rmuraglia
      url-base: https://github.com/rmuraglia
  projects:
    - name: zmk
      remote: infused-kim
      revision: pr-testing/mouse_ps2_module_base
      import: app/west.yml
    - name: zmk-fingerpunch-keyboards
      remote: sadekbaroudi
      revision: main
      import: config/deps.yml
    - name: kb_zmk_ps2_mouse_trackpoint_driver
      remote: infused-kim
      revision: main
    - name: zmk-rgbled-widget
      remote: caksoylar
      revision: main
    - name: zmk-behavior-insomnia
      remote: badjeff
      revision: main
    - name: zmk-keyboards-menura
      remote: rmuraglia
      revision: main
  self:
    path: config
```
